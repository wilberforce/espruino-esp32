## app/sdkconfig.defaults
```kconfig
# Espruino settings
#
#CONFIG_BT_ENABLED=n
#CONFIG_ESPTOOLPY_BAUD_115200B=n
CONFIG_ESPTOOLPY_BAUD_921600B=y
CONFIG_TASK_WDT=n
CONFIG_INT_WDT_CHECK_CPU1=n
CONFIG_FREERTOS_UNICORE=y
CONFIG_FREERTOS_HZ=1000
CONFIG_FREERTOS_ASSERT_ON_UNTESTED_FUNCTION=n
CONFIG_LWIP_SO_REUSE=y
```
